## components/ai_face_recognition/Kconfig
```kconfig
config AI_FACE_RECOGNITION_ENABLED
    bool "ai_face_recognition enabled"
    default y
```

## components/camera_driver/Kconfig
```kconfig
menu "Camera driver"

    choice CAMERA_FRAME_SIZE
        prompt "Frame size"
        default CAMERA_FRAME_SIZE_QVGA
        help
            Bigger frames find smaller (farther) faces but make detection
            slower. QVGA is what Espressif's face examples use on ESP32-S3.

        config CAMERA_FRAME_SIZE_QVGA
            bool "QVGA (320x240)"
        config CAMERA_FRAME_SIZE_HVGA
            bool "HVGA (480x320)"
        config CAMERA_FRAME_SIZE_VGA
            bool "VGA (640x480)"
    endchoice

    config CAMERA_XCLK_FREQ_HZ
        int "XCLK frequency (Hz)"
        default 20000000

    config CAMERA_VFLIP
        bool "Flip image vertically"
        default n

    config CAMERA_HMIRROR
        bool "Mirror image horizontally"
        default n

    menu "Camera pins"
        comment "Defaults match the custom OV5640 board. -1 = not connected."

        config CAMERA_PIN_PWDN
            int "PWDN"
            default -1
        config CAMERA_PIN_RESET
            int "RESET"
            default -1
        config CAMERA_PIN_XCLK
            int "XCLK"
            default 15
        config CAMERA_PIN_SIOD
            int "SIOD (SCCB SDA)"
            default 4
        config CAMERA_PIN_SIOC
            int "SIOC (SCCB SCL)"
            default 5
        config CAMERA_PIN_D7
            int "D7"
            default 16
        config CAMERA_PIN_D6
            int "D6"
            default 17
        config CAMERA_PIN_D5
            int "D5"
            default 18
        config CAMERA_PIN_D4
            int "D4"
            default 12
        config CAMERA_PIN_D3
            int "D3"
            default 10
        config CAMERA_PIN_D2
            int "D2"
            default 8
        config CAMERA_PIN_D1
            int "D1"
            default 9
        config CAMERA_PIN_D0
            int "D0"
            default 11
        config CAMERA_PIN_VSYNC
            int "VSYNC"
            default 6
        config CAMERA_PIN_HREF
            int "HREF"
            default 7
        config CAMERA_PIN_PCLK
            int "PCLK"
            default 13
    endmenu

endmenu
```

## components/data_handler/Kconfig
```kconfig
menu "Data Handler Configuration"

config DATA_HANDLER_QUEUE_LENGTH
    int "Frame Queue Length"
    default 5
    help
      Length of the FreeRTOS queue to buffer camera frames.

config DATA_HANDLER_FRAME_SIZE
    int "Maximum Frame Size"
    default 307200
    help
      Maximum size of a camera frame in bytes (e.g., 640x480 RGB).

endmenu
```

## components/door_control/Kconfig
```kconfig
menu "Door control"

    config DOOR_LOCK_GPIO
        int "Lock output GPIO"
        range 0 48
        default 2
        help
            GPIO that drives the lock relay or MOSFET. Must not be used by
            the camera or by flash/PSRAM.

    config DOOR_LOCK_ACTIVE_HIGH
        bool "Lock opens when the GPIO is high"
        default y
        help
            Turn off for relay boards that switch on a low input.

endmenu
```

## components/face_db/Kconfig
```kconfig
menu "Face store (face_db)"

    config FACE_DB_MAX_FACES
        int "Maximum number of enrolled faces"
        range 1 50
        default 20
        help
            Each face uses about 2 KB of RAM (PSRAM) and one 4 KB NVS page,
            so the 256 KB "face_nvs" partition holds about 60. Grow it in
            partitions.csv before raising this range.
            Several enrollments of one person count as several faces.

    config FACE_DB_NVS_PARTITION
        string "NVS partition label for faces"
        default "face_nvs"
        help
            Must match a data/nvs partition in partitions.csv. Kept apart
            from the default "nvs" partition so erasing faces never erases
            Wi-Fi or calibration settings.

endmenu
```

## components/feedback/Kconfig
```kconfig
menu "Feedback (buzzer and RGB LED)"

    config FEEDBACK_BUZZER_GPIO
        int "Buzzer GPIO (-1 = none)"
        range -1 48
        default -1
        help
            Active buzzer (it beeps by itself when powered), on when the
            GPIO is high. Drive it through a transistor if it needs more
            than about 20 mA. GPIO 14 is free on the default pin map.

    config FEEDBACK_RGB_LED_GPIO
        int "RGB LED (WS2812) GPIO (-1 = none)"
        range -1 48
        default -1
        help
            Data pin of one addressable RGB LED (WS2812). The LED on the
            ESP32-S3-DevKitC-1 is on GPIO 48 or 38, depending on the board
            version: check the silkscreen. GPIO 21 is free on the default
            pin map for an external one.

endmenu
```

## components/keypad_input/Kconfig
```kconfig
config KEYPAD_INPUT_ENABLED
    bool "Enable keypad_input component"
    default y
```

## components/net_comm/Kconfig
```kconfig
menu "Network (net_comm)"

    config NET_COMM_WIFI_SSID
        string "Wi-Fi network name (empty = Wi-Fi off)"
        default ""
        help
            Name of the Wi-Fi network to join as a station. Leave empty to
            run without Wi-Fi (events are only logged). The value lands in
            sdkconfig, which is not committed to git.

    config NET_COMM_WIFI_PASSWORD
        string "Wi-Fi password"
        default ""
        help
            Password of the Wi-Fi network. Empty means an open network.

    config NET_COMM_WIFI_RETRY_DELAY_MS
        int "Delay before a reconnect attempt (ms)"
        range 1000 60000
        default 5000

endmenu
```

## components/system_logic/Kconfig
```kconfig
menu "System logic (unlock rules)"

    config SYSTEM_LOGIC_MIN_SIMILARITY_PERCENT
        int "Minimum similarity to accept a face (percent)"
        range 30 95
        default 55
        help
            Cosine similarity x 100 between the seen face and the best
            enrolled face. Higher = fewer wrong people let in, but more
            retries for the right person. ESP-DL's own default is 50.
            Watch "status" in the console to tune it on your faces.

    config SYSTEM_LOGIC_CONFIRM_FRAMES
        int "Frames in a row needed to decide"
        range 1 10
        default 3
        help
            The same result (same known face, or unknown) must be seen on
            this many frames in a row before the door opens or a face is
            rejected. Also the number of face frames needed to enroll.

    config SYSTEM_LOGIC_UNLOCK_HOLD_MS
        int "Unlock hold time (ms)"
        range 500 60000
        default 3000

    config SYSTEM_LOGIC_COOLDOWN_MS
        int "Cooldown after unlock, reject or enroll (ms)"
        range 0 60000
        default 2000

    config SYSTEM_LOGIC_ENROLL_TIMEOUT_MS
        int "Enroll timeout (ms)"
        range 1000 120000
        default 15000

    config SYSTEM_LOGIC_ENROLL_BUTTON_GPIO
        int "Enroll button GPIO (-1 = none)"
        range -1 48
        default 0
        help
            Active-low button with internal pull-up. GPIO 0 is the BOOT
            button on most ESP32-S3 boards. A press enrolls the next face
            as "user_<n>".

    config SYSTEM_LOGIC_TASK_STACK_SIZE
        int "Recognition task stack size (bytes)"
        default 12288

    config SYSTEM_LOGIC_TASK_PRIORITY
        int "Recognition task priority"
        range 1 20
        default 5

endmenu
```

## components/video_stream/Kconfig
```kconfig
menu "Video stream"

    config VIDEO_STREAM_ENABLE
        bool "Serve the camera over HTTP (/, /stream, /jpg)"
        default y
        help
            Live MJPEG view of the camera for a browser or phone on the
            same Wi-Fi. Needs a Wi-Fi SSID in "Network (net_comm)".
            No login: anyone on the Wi-Fi can watch.

    if VIDEO_STREAM_ENABLE

        config VIDEO_STREAM_JPEG_QUALITY
            int "JPEG quality (1-100)"
            range 1 100
            default 80

        config VIDEO_STREAM_MAX_FPS
            int "Frame rate limit (frames per second)"
            range 1 30
            default 10
            help
                Streaming shares the camera and PSRAM with face
                recognition; keep this modest.

    endif

endmenu
```
